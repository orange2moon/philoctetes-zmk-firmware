## boards/shields/philoctetes/Kconfig.defconfig
```kconfig
if SHIELD_PHILOCTETES_LEFT

# Name must be less than 16 characters long!
config ZMK_KEYBOARD_NAME
    default "Philoctetes"

config ZMK_SPLIT_ROLE_CENTRAL
    default y

config ZMK_POINTING
    default y

# Assuming pointing device uses SPI
config SPI
    default y

endif

if SHIELD_PHILOCTETES_LEFT || SHIELD_PHILOCTETES_RIGHT

config ZMK_SPLIT
    default y

endif
```
